## config/west.yml
```yaml
manifest:
  remotes:
    - name: zmkfirmware
      url-base: https://github.com/zmkfirmware
    - name: urob
      url-base: https://github.com/urob
    - name: tanmayv-ftc
      url-base: https://github.com/tanmayv
  projects:
    - name: zmk
      remote: tanmayv-ftc
      revision: mouse-ftc
      import: app/west.yml
  self:
    path: config
```
